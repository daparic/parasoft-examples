;------------------------------------------------------------------------
;                                                                       |
;   FILE        :vect.inc                                               |
;   DATE        :Tue, Nov 09, 2010                                      |
;   DESCRIPTION :Definition of Vector                                   |
;   CPU TYPE    :SH7760                                                 |
;                                                                       |
;   This file is generated by Renesas Project Generator (Ver.4.16).     |
;                                                                       |
;------------------------------------------------------------------------
                  


;<<VECTOR DATA START (POWER ON RESET)>>
        ;H'000 Power On Reset (H-UDI RESET)
        .global	_PowerON_Reset                                                                                                                  
;<<VECTOR DATA END (POWER ON RESET)>>
;<<VECTOR DATA START (MANUAL RESET)>>
        ;H'020 Manual Reset
        .global	_Manual_Reset                                                                                                                   
;<<VECTOR DATA END (MANUAL RESET)>>
        ;H'040 TLB miss/invalid (load)
        .global         _INT_TLBMiss_Load
        ;H'060 TLB miss/invalid (store)
        .global         _INT_TLBMiss_Store
        ;H'080 Initial page write
        .global         _INT_TLBInitial_Page
        ;H'0A0 TLB protect (load)
        .global         _INT_TLBProtect_Load
        ;H'0C0 TLB protect (store)
        .global         _INT_TLBProtect_Store
        ;H'0E0 Address error (load)
        .global         _INT_Address_load
        ;H'100 Address error (store)
        .global         _INT_Address_store
        ;H'120 FPU invalid
        .global         _INT_FPU
        ;H'140 TBL Reset (DATA TBL Reset)
        .global         _TBL_Reset
        ;H'160 TRAPA
        .global         _INT_TRAPA
        ;H'180 Illegal code
        .global         _INT_Illegal_code
        ;H'1A0 Illegal slot
        .global         _INT_Illegal_slot
        ;H'1C0 NMI
        .global         _INT_NMI
        ;H'1E0 User Break
        .global         _INT_User_Break
        ;H'200 External hardware interrupt
        .global         _INT_Extern_0000
        ;H'220 External hardware interrupt
        .global         _INT_Extern_0001
        ;H'240 External hardware interrupt
        .global         _INT_Extern_0010
        ;H'260 External hardware interrupt
        .global         _INT_Extern_0011
        ;H'280 External hardware interrupt
        .global         _INT_Extern_0100
        ;H'2A0 External hardware interrupt
        .global         _INT_Extern_0101
        ;H'2C0 External hardware interrupt
        .global         _INT_Extern_0110
        ;H'2E0 External hardware interrupt
        .global         _INT_Extern_0111
        ;H'300 External hardware interrupt
        .global         _INT_Extern_1000
        ;H'320 External hardware interrupt
        .global         _INT_Extern_1001
        ;H'340 External hardware interrupt
        .global         _INT_Extern_1010
        ;H'360 External hardware interrupt
        .global         _INT_Extern_1011
        ;H'380 External hardware interrupt
        .global         _INT_Extern_1100
        ;H'3A0 External hardware interrupt
        .global         _INT_Extern_1101
        ;H'3C0 External hardware interrupt
        .global         _INT_Extern_1110
        ;H'3E0 Reserved
        .global         _INT_Reserved3E0
        ;H'400 TMU TUNI0
        .global         _INT_TMU_TUNI0
        ;H'420 TMU TUNI1
        .global         _INT_TMU_TUNI1
        ;H'440 TMU TUNI2
        .global         _INT_TMU_TUNI2
        ;H'460 TMU TICPI2
        .global         _INT_TMU_TICPI2
        ;H'480 Reserved
        .global         _INT_Reserved480
        ;H'4A0 Reserved
        .global         _INT_Reserved4A0
        ;H'4C0 Reserved
        .global         _INT_Reserved4C0
        ;H'4E0 Reserved
        .global         _INT_Reserved4E0
        ;H'500 Reserved
        .global         _INT_Reserved500
        ;H'520 Reserved
        .global         _INT_Reserved520
        ;H'540 Reserved
        .global         _INT_Reserved540
        ;H'560 WDT ITI
        .global         _INT_WDT_ITI
        ;H'580 REF RCMI
        .global         _INT_REF_RCMI
        ;H'5A0 REF ROVI
        .global         _INT_REF_ROVI
        ;H'5C0 Reserved
        .global         _INT_Reserved5C0
        ;H'5E0 Reserved
        .global         _INT_Reserved5E0
        ;H'600 H-UDI
        .global         _INT_HUDI
        ;H'620 GPIO GPIOI
        .global         _INT_GPIO_GPIOI
        ;H'640 DMAC DMTE0
        .global         _INT_DMAC_DMTE0
        ;H'660 DMAC DMTE1
        .global         _INT_DMAC_DMTE1
        ;H'680 DMAC DMTE2
        .global         _INT_DMAC_DMTE2
        ;H'6A0 DMAC DMTE3
        .global         _INT_DMAC_DMTE3
        ;H'6C0 DMAC DMAE
        .global         _INT_DMAC_DMAE
        ;H'6E0 Reserved
        .global         _INT_Reserved6E0
        ;H'700 Reserved
        .global         _INT_Reserved700
        ;H'720 Reserved
        .global         _INT_Reserved720
        ;H'740 Reserved
        .global         _INT_Reserved740
        ;H'760 Reserved
        .global         _INT_Reserved760
        ;H'780 DMAC DMTE4
        .global         _INT_DMAC_DMTE4
        ;H'7A0 DMAC DMTE5
        .global         _INT_DMAC_DMTE5
        ;H'7C0 DMAC DMTE6
        .global         _INT_DMAC_DMTE6
        ;H'7E0 DMAC DMTE7
        .global         _INT_DMAC_DMTE7
        ;H'800 Illegal FPU
        .global         _INT_Illegal_FPU
        ;H'820 Illegal slot FPU
        .global         _INT_Illegal_slot_FPU
        ;H'840 IRQ IRQ6
        .global         _INT_IRQ_IRQ6
        ;H'860 IRQ IRQ7
        .global         _INT_IRQ_IRQ7
        ;H'880 SCIF ERI0
        .global         _INT_SCIF_ERI0
        ;H'8A0 SCIF RXI0
        .global         _INT_SCIF_RXI0
        ;H'8C0 SCIF BRI0
        .global         _INT_SCIF_BRI0
        ;H'8E0 SCIF TXI0
        .global         _INT_SCIF_TXI0
        ;H'900 HCAN2 CANI0
        .global         _INT_HCAN2_CANI0
        ;H'920 HCAN2 CANI1
        .global         _INT_HCAN2_CANI1
        ;H'940 SSI SSII0
        .global         _INT_SSI_SSII0
        ;H'960 SSI SSII1
        .global         _INT_SSI_SSII1
        ;H'980 HAC HACI0
        .global         _INT_HAC_HACI0
        ;H'9A0 HAC HACI1
        .global         _INT_HAC_HACI1
        ;H'9C0 IIC IICI0
        .global         _INT_IIC_IICI0
        ;H'9E0 IIC IICI1
        .global         _INT_IIC_IICI1
        ;H'A00 USB USBI
        .global         _INT_USB_USBI
        ;H'A20 LCDC VINT
        .global         _INT_LCDC_VINT
        ;H'A40 Reserved
        .global         _INT_ReservedA40
        ;H'A60 Reserved
        .global         _INT_ReservedA60
        ;H'A80 DMABRG DMABRGI0
        .global         _INT_DMABRG_DMABRGI0
        ;H'AA0 DMABRG DMABRGI1
        .global         _INT_DMABRG_DMABRGI1
        ;H'AC0 DMABRG DMABRGI2
        .global         _INT_DMABRG_DMABRGI2
        ;H'AE0 Reserved
        .global         _INT_ReservedAE0
        ;H'B00 SCIF ERI1
        .global         _INT_SCIF_ERI1
        ;H'B20 SCIF RXI1
        .global         _INT_SCIF_RXI1
        ;H'B40 SCIF BRI1
        .global         _INT_SCIF_BRI1
        ;H'B60 SCIF TXI1
        .global         _INT_SCIF_TXI1
        ;H'B80 SCIF ERI2
        .global         _INT_SCIF_ERI2
        ;H'BA0 SCIF RXI2
        .global         _INT_SCIF_RXI2
        ;H'BC0 SCIF BRI2
        .global         _INT_SCIF_BRI2
        ;H'BE0 SCIF TXI2
        .global         _INT_SCIF_TXI2
        ;H'C00 SIM SIMERI
        .global         _INT_SIM_SIMERI
        ;H'C20 SIM SIMRXI
        .global         _INT_SIM_SIMRXI
        ;H'C40 SIM SIMTXI
        .global         _INT_SIM_SIMTXI
        ;H'C60 SIM SIMTEI
        .global         _INT_SIM_SIMTEI
        ;H'C80 HSPI SPII
        .global         _INT_HSPI_SPII
        ;H'CA0 Reserved
        .global         _INT_ReservedCA0
        ;H'CC0 Reserved
        .global         _INT_ReservedCC0
        ;H'CE0 Reserved
        .global         _INT_ReservedCE0
        ;H'D00 MMCIF MMCI0
        .global         _INT_MMCIF_MMCI0
        ;H'D20 MMCIF MMCI1
        .global         _INT_MMCIF_MMCI1
        ;H'D40 MMCIF MMCI2
        .global         _INT_MMCIF_MMCI2
        ;H'D60 MMCIF MMCI3
        .global         _INT_MMCIF_MMCI3
        ;H'D80 Reserved
        .global         _INT_ReservedD80
        ;H'DA0 Reserved
        .global         _INT_ReservedDA0
        ;H'DC0 Reserved
        .global         _INT_ReservedDC0
        ;H'DE0 Reserved
        .global         _INT_ReservedDE0
        ;H'E00 Reserved
        .global         _INT_ReservedE00
        ;H'E20 Reserved
        .global         _INT_ReservedE20
        ;H'E40 Reserved
        .global         _INT_ReservedE40
        ;H'E60 Reserved
        .global         _INT_ReservedE60
        ;H'E80 MFI MFII
        .global         _INT_MFI_MFII
        ;H'EA0 Reserved
        .global         _INT_ReservedEA0
        ;H'EC0 Reserved
        .global         _INT_ReservedEC0
        ;H'EE0 Reserved
        .global         _INT_ReservedEE0
        ;H'F00 Reserved
        .global         _INT_ReservedF00
        ;H'F20 Reserved
        .global         _INT_ReservedF20
        ;H'F40 Reserved
        .global         _INT_ReservedF40
        ;H'F60 Reserved
        .global         _INT_ReservedF60
        ;H'F80 ADC ADI
        .global         _INT_ADC_ADI
        ;H'FA0 CMT CMTI
        .global         _INT_CMT_CMTI
